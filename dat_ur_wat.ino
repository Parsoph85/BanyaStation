/*
Схема: Коллектор транзисторов вешаем на общий +5В (на ардуино?), Базы подключаем к датчикм-щупам,
Корпус тоже кидаем на +5В(но с питания?). Эмиттеры тыкаем на выводы ардуино Д2-Д11.
Возможно, нужно сопротивление воткнуть.
  ------
  |  8 |
  |    |
  ------
   | | |
   | | |
   К Б Э

   Для матрицы нам надо 7 выводов. 4 на выход, 3 на вход. Алгоритм опроса - ставим на выход +
   Опрашиваем входы, где + там и число.

*/

int bPin[7]; // номера выводов 
int bState[7]; // переменная для хранения состояния
int levWater = 0; // уровень воды
String errWat = ""; // ошибка


void setup() { // задаем константы и переменные

  Serial.begin(9600);//инициализация вывода в порт

  for (int i = 1; i <= 7; i++) {// заполним все ячейки значением номер входа, подключенный к датчику
    bPin[i] = i + 1;
  }

  for (int i = 1; i <= 7; i++) {// заполним все ячейки значением переменная для хранения состояния датчиков
    bState[i] = 0;
  }
  
  for (int i = 5; i <= 7; i++) {// инициализируем пин, подключенный к датчику, как вход
    pinMode(bPin[i], INPUT);
  }
  
  for (int i = 1; i <= 4; i++) {// инициализируем пин, подключенный к датчику, как выход
    pinMode(bPin[i], OUTPUT);
  }
}
 
void loop(){
  
  int error = 0; //сброс значения
  
  for (int x = 1; x <= 4; x++) { // считываем значения с входаx x - номера выводов, ставим + и считываем
    bState[x] = 1;
    for (int y = 5; y <= 7; y++) { // на каждом входе. Потом, если +, то вычисляем значение
      bState[y] = digitalRead(bPin[y]);
      if (bState[y] == HIGH) {   
        levWater = (( x - 1 ) * 3 + y) * 10; // x - порты вывода - 4 штуки, y  - порты ввода - 3 штуки
          if (error == 1){
            errWat = "error";
          }
      }     
    }
    bState[x] = 0;
  }

  Serial.println(levWater); //вывод в порт
  Serial.println(errWat);
  
  delay (3000);// пауза между запросами. сделать можно чуть больше


}
